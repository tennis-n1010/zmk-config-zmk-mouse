## boards/shields/zmk_mouse/Kconfig.defconfig
```kconfig
if SHIELD_ZMK_MOUSE

# Name must be less than 16 characters long!
config ZMK_KEYBOARD_NAME
    default "ZMK Mouse"

endif
```

## config/west.yml
```yaml
manifest:
  defaults:
    revision: v0.3
  remotes:
    - name: zmkfirmware
      url-base: https://github.com/zmkfirmware
    - name: tennis-n1010
      url-base: https://github.com/tennis-n1010
  projects:
    - name: zmk
      remote: zmkfirmware
      import: app/west.yml
    - name: zmk-pmw3610-driver
      remote: tennis-n1010
      revision: main
  self:
    path: config
```
